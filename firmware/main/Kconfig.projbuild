## firmware/main/Kconfig.projbuild
```kconfig
menu "CodeBlue"

    config CODEBLUE_BOARD_NAME
        string "Board name"
        default "ESP32-S3 board"
        help
            Reported to the viewer in INFO. Set by the board preset
            (boards/*.defaults).

    config CODEBLUE_LED_GPIO
        int "Status LED GPIO (WS2812, -1 = none)"
        range -1 48
        default 48
        help
            GPIO driving the board's addressable RGB LED, until the viewer
            sets another (it's saved on the board). ESP32-S3-DevKitC-1 v1.0
            boards and most clones use GPIO48; v1.1 boards use GPIO38.

    config CODEBLUE_LED_BRIGHTNESS
        int "Default status LED brightness (percent)"
        range 0 100
        default 5
        help
            Used until the viewer sets a brightness (which can be saved on
            the board). 5% is plenty for an indicator LED.

    config CODEBLUE_USB_VID
        hex "USB vendor ID"
        default 0x303A
        help
            What the target sees. The default is Espressif's vendor ID with
            TinyUSB's default HID product ID, which Espressif allows for
            devices using standard USB classes, as CodeBlue does. Change
            these only for a product with its own allocated IDs.

    config CODEBLUE_USB_PID
        hex "USB product ID"
        default 0x4004

    config CODEBLUE_VBUS_GPIO
        int "VBUS sense GPIO (-1 = none)"
        range -1 48
        default -1
        help
            Only for boards with the VBUS sense modification
            (docs/hardware/vbus-sense.md): a 2:3 resistor divider from
            the native USB port's 5 V to this GPIO, so the viewer can tell a
            sleeping target from an unplugged one. Usually set from the
            viewer instead (it's saved on the board); this is only the
            default until then. GPIO21 suits the DevKitC-1 and its clones.
            Leave at -1 on an unmodified board: a floating pin would report
            USB power at random.

    config CODEBLUE_UART_LOGS
        bool "Keep logging on the UART after start-up (breaks the protocol)"
        default n
        help
            The UART carries the host protocol, so logging normally stops
            once the firmware is up. Turn this on only for bring-up with
            idf.py monitor; the viewer will not work reliably.

endmenu
```
